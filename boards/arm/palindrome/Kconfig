## boards/arm/palindrome/Kconfig
```kconfig
# Copyright (c) 2026 Brandon Beltran
# SPDX-License-Identifier: MIT

config BOARD_ENABLE_DCDC
    bool "Enable DCDC mode"
    select SOC_DCDC_NRF52X
    default y
    depends on (BOARD_PALINDROME_LEFT || BOARD_PALINDROME_RIGHT)
```

## boards/arm/palindrome/Kconfig.board
```kconfig
# Copyright (c) 2026 Brandon Beltran
# SPDX-License-Identifier: MIT

config BOARD_PALINDROME_LEFT
    bool "palindrome_left"
    depends on SOC_NRF52840_QIAA

config BOARD_PALINDROME_RIGHT
    bool "palindrome_right"
    depends on SOC_NRF52840_QIAA
```

## boards/arm/palindrome/Kconfig.defconfig
```kconfig
# Copyright (c) 2026 Brandon Beltran
# SPDX-License-Identifier: MIT

if BOARD_PALINDROME_LEFT

config ZMK_KEYBOARD_NAME
    default "Palindrome"

config ZMK_SPLIT_ROLE_CENTRAL
    default y

endif # left

if BOARD_PALINDROME_LEFT || BOARD_PALINDROME_RIGHT

config BOARD
    default "palindrome"

config ZMK_SPLIT
    default y

config BT_CTLR
    default BT

if USB_DEVICE_STACK

config USB_NRFX
    default y

endif # USB

endif
```
